## platform/Config.in
```kconfig
menu "Wana OS"
source "$BR2_EXTERNAL_WANA_PATH/package/wana-init/Config.in"
source "$BR2_EXTERNAL_WANA_PATH/package/wana-drm/Config.in"
source "$BR2_EXTERNAL_WANA_PATH/package/wana-render/Config.in"
source "$BR2_EXTERNAL_WANA_PATH/package/wana-input/Config.in"
source "$BR2_EXTERNAL_WANA_PATH/package/wana-compositor/Config.in"
source "$BR2_EXTERNAL_WANA_PATH/package/wana-fonts/Config.in"
source "$BR2_EXTERNAL_WANA_PATH/package/wana-text/Config.in"
source "$BR2_EXTERNAL_WANA_PATH/package/wana-libglibutil/Config.in"
source "$BR2_EXTERNAL_WANA_PATH/package/wana-libgbinder/Config.in"
source "$BR2_EXTERNAL_WANA_PATH/package/wana-python-gbinder/Config.in"
source "$BR2_EXTERNAL_WANA_PATH/package/wana-waydroid/Config.in"
source "$BR2_EXTERNAL_WANA_PATH/package/wana-platform/Config.in"
source "$BR2_EXTERNAL_WANA_PATH/package/wana-wine64/Config.in"
endmenu
```

## platform/configs/wana_x86_64_defconfig
```kconfig
BR2_x86_64=y
BR2_KERNEL_HEADERS_6_18=y
BR2_TOOLCHAIN_BUILDROOT_CXX=y
BR2_CCACHE=y
BR2_REPRODUCIBLE=y
BR2_TARGET_GENERIC_HOSTNAME="wana"
BR2_TARGET_GENERIC_ISSUE="Wana OS"
BR2_INIT_NONE=y
BR2_ROOTFS_DEVICE_CREATION_DYNAMIC_EUDEV=y
BR2_ROOTFS_USERS_TABLES="$(BR2_EXTERNAL_WANA_PATH)/board/x86_64/users.table"
BR2_ROOTFS_POST_BUILD_SCRIPT="$(BR2_EXTERNAL_WANA_PATH)/board/x86_64/post-build.sh"
BR2_ROOTFS_POST_IMAGE_SCRIPT="$(BR2_EXTERNAL_WANA_PATH)/board/x86_64/post-image.sh"
BR2_LINUX_KERNEL=y
BR2_LINUX_KERNEL_CUSTOM_VERSION=y
BR2_LINUX_KERNEL_CUSTOM_VERSION_VALUE="6.18.33"
BR2_LINUX_KERNEL_USE_ARCH_DEFAULT_CONFIG=y
BR2_LINUX_KERNEL_CONFIG_FRAGMENT_FILES="$(BR2_EXTERNAL_WANA_PATH)/board/x86_64/linux.fragment"
BR2_LINUX_KERNEL_NEEDS_HOST_OPENSSL=y
BR2_LINUX_KERNEL_NEEDS_HOST_LIBELF=y
BR2_PACKAGE_MESA3D=y
BR2_PACKAGE_MESA3D_GALLIUM_DRIVER_SOFTPIPE=y
BR2_PACKAGE_MESA3D_GALLIUM_DRIVER_VIRGL=y
BR2_PACKAGE_MESA3D_OPENGL_ES=y
# BR2_PACKAGE_EUDEV_MODULE_LOADING is not set
# BR2_PACKAGE_EUDEV_ENABLE_HWDB is not set
BR2_PACKAGE_WAYLAND_UTILS=y
BR2_TARGET_ROOTFS_CPIO=y
BR2_TARGET_ROOTFS_CPIO_ZSTD=y
BR2_TARGET_ROOTFS_EXT2=y
BR2_TARGET_ROOTFS_EXT2_4=y
BR2_TARGET_ROOTFS_EXT2_LABEL="wana-root"
BR2_TARGET_ROOTFS_EXT2_SIZE="256M"
BR2_TARGET_ROOTFS_EXT2_MKFS_OPTIONS="-O ^64bit -U 5d9f6a52-7e1b-4c3a-9b8e-0a1a57a0a0f5 -E hash_seed=5d9f6a52-7e1b-4c3a-9b8e-0a1a57a0a0f6"
BR2_TARGET_GRUB2=y
BR2_TARGET_GRUB2_X86_64_EFI=y
BR2_TARGET_GRUB2_BUILTIN_MODULES_EFI="boot linux ext2 fat part_gpt normal efi_gop serial terminal test configfile echo"
BR2_PACKAGE_HOST_DOSFSTOOLS=y
BR2_PACKAGE_HOST_GENIMAGE=y
BR2_PACKAGE_HOST_MTOOLS=y
BR2_PACKAGE_WANA_INIT=y
BR2_PACKAGE_WANA_RENDER=y
BR2_PACKAGE_WANA_INPUT=y
BR2_PACKAGE_WANA_COMPOSITOR=y
```

## platform/package/wana-compositor/Config.in
```kconfig
config BR2_PACKAGE_WANA_COMPOSITOR
	bool "wana-compositor"
	depends on BR2_PACKAGE_HOST_RUSTC_TARGET_ARCH_SUPPORTS
	depends on !BR2_STATIC_LIBS # wayland
	depends on BR2_TOOLCHAIN_HAS_THREADS # wayland
	depends on BR2_PACKAGE_HAS_LIBEGL && BR2_PACKAGE_HAS_LIBGLES && BR2_PACKAGE_HAS_LIBGBM
	depends on BR2_PACKAGE_HAS_UDEV # libinput
	depends on BR2_INSTALL_LIBSTDCPP # harfbuzz (wana-text)
	depends on BR2_TOOLCHAIN_HAS_SYNC_4 # harfbuzz
	depends on BR2_TOOLCHAIN_GCC_AT_LEAST_4_9 # harfbuzz
	select BR2_PACKAGE_HOST_RUSTC
	select BR2_PACKAGE_LIBINPUT
	select BR2_PACKAGE_LIBXKBCOMMON
	select BR2_PACKAGE_XKEYBOARD_CONFIG # runtime: keymap data
	select BR2_PACKAGE_WANA_TEXT # wana-wl-test --text
	select BR2_PACKAGE_WAYLAND
	select BR2_PACKAGE_WAYLAND_PROTOCOLS # build time: protocol XML
	help
	  Wana OS Wayland compositor, on libwayland-server (decision
	  0001) with protocol tables generated from the protocol XML,
	  drawing with GLES (wana-render) on DRM/KMS (wana-drm), with
	  input from libinput + xkbcommon (wana-input); wana-shell,
	  the desktop shell it starts on a private connection
	  (decision 0003); and wana-wl-test, the Wayland test client.

comment "wana-compositor needs EGL, OpenGL ES and GBM (mesa3d)"
	depends on !(BR2_PACKAGE_HAS_LIBEGL && BR2_PACKAGE_HAS_LIBGLES && BR2_PACKAGE_HAS_LIBGBM)

comment "wana-compositor needs udev (/dev management: eudev)"
	depends on !BR2_PACKAGE_HAS_UDEV
```

## platform/package/wana-drm/Config.in
```kconfig
config BR2_PACKAGE_WANA_DRM
	bool "wana-drm"
	depends on BR2_PACKAGE_HOST_RUSTC_TARGET_ARCH_SUPPORTS
	select BR2_PACKAGE_HOST_RUSTC
	help
	  Wana OS DRM/KMS backend and the wana-kms bring-up tool:
	  display discovery, modesetting and page flipping through
	  the kernel DRM uAPI.
```

## platform/package/wana-fonts/Config.in
```kconfig
config BR2_PACKAGE_WANA_FONTS
	bool "wana-fonts"
	help
	  The fonts Wana's own UI uses, pinned: Noto Naskh Arabic,
	  Noto Sans Arabic and Noto Sans (variable fonts, OFL-1.1),
	  downloaded as single files from google/fonts at a fixed
	  commit and checked against wana-fonts.hash. Installed in
	  /usr/share/fonts/wana with a SHA256SUMS file that
	  wana-text verifies at run time.
```

## platform/package/wana-init/Config.in
```kconfig
config BR2_PACKAGE_WANA_INIT
	bool "wana-init"
	depends on BR2_PACKAGE_HOST_RUSTC_TARGET_ARCH_SUPPORTS
	select BR2_PACKAGE_HOST_RUSTC
	help
	  Wana OS init (PID 1): early mounts, system identity,
	  process reaping and console shell supervision.
	  Installed as /usr/sbin/wana-init; /init and /sbin/init
	  point to it (see board post-build script).
```

## platform/package/wana-input/Config.in
```kconfig
config BR2_PACKAGE_WANA_INPUT
	bool "wana-input"
	depends on BR2_PACKAGE_HOST_RUSTC_TARGET_ARCH_SUPPORTS
	depends on BR2_PACKAGE_HAS_UDEV
	select BR2_PACKAGE_HOST_RUSTC
	select BR2_PACKAGE_LIBINPUT
	select BR2_PACKAGE_LIBXKBCOMMON
	select BR2_PACKAGE_XKEYBOARD_CONFIG # runtime: keymap data
	help
	  Wana OS input: devices and events from udev + libinput,
	  keyboard layouts from xkbcommon, and the wana-input
	  bring-up tool.

comment "wana-input needs udev (/dev management: eudev)"
	depends on !BR2_PACKAGE_HAS_UDEV
```

## platform/package/wana-libgbinder/Config.in
```kconfig
config BR2_PACKAGE_WANA_LIBGBINDER
	bool "wana-libgbinder"
	depends on BR2_USE_MMU
	depends on BR2_TOOLCHAIN_HAS_THREADS
	select BR2_PACKAGE_LIBGLIB2
	select BR2_PACKAGE_WANA_LIBGLIBUTIL
	help
	  Pinned Android Binder userspace library for Wana OS.

	  https://github.com/mer-hybris/libgbinder
```

## platform/package/wana-libglibutil/Config.in
```kconfig
config BR2_PACKAGE_WANA_LIBGLIBUTIL
	bool "wana-libglibutil"
	depends on BR2_USE_MMU
	depends on BR2_TOOLCHAIN_HAS_THREADS
	select BR2_PACKAGE_LIBGLIB2
	help
	  Pinned libglibutil runtime used by Wana OS Android compatibility.

	  https://github.com/sailfishos/libglibutil
```

## platform/package/wana-platform/Config.in
```kconfig
config BR2_PACKAGE_WANA_PLATFORM
	bool "wana-platform"
	depends on BR2_x86_64
	depends on BR2_USE_MMU
	depends on !BR2_STATIC_LIBS
	depends on BR2_TOOLCHAIN_HAS_THREADS
	select BR2_PACKAGE_DBUS
	depends on BR2_PACKAGE_EMBIGGEN_DISK
	select BR2_PACKAGE_DHCPCD
	select BR2_PACKAGE_WPA_SUPPLICANT
	select BR2_PACKAGE_WPA_SUPPLICANT_NL80211
	select BR2_PACKAGE_WPA_SUPPLICANT_WPA3
	select BR2_PACKAGE_WPA_SUPPLICANT_CLI
	select BR2_PACKAGE_WPA_SUPPLICANT_PASSPHRASE
	select BR2_PACKAGE_WPA_SUPPLICANT_DBUS
	select BR2_PACKAGE_WPA_SUPPLICANT_DBUS_INTROSPECTION
	select BR2_PACKAGE_ALSA_LIB
	select BR2_PACKAGE_ALSA_UTILS
	select BR2_PACKAGE_PIPEWIRE
	select BR2_PACKAGE_LUA
	select BR2_PACKAGE_WIREPLUMBER
	select BR2_PACKAGE_BLUEZ5_UTILS
	select BR2_PACKAGE_BLUEZ5_UTILS_CLIENT
	select BR2_PACKAGE_BLUEZ5_UTILS_PLUGINS_AUDIO
	select BR2_PACKAGE_BLUEZ5_UTILS_PLUGINS_HID
	select BR2_PACKAGE_BLUEZ5_UTILS_PLUGINS_HOG
	select BR2_PACKAGE_SBC
	select BR2_PACKAGE_LIBSNDFILE
	select BR2_PACKAGE_LXC
	depends on BR2_PACKAGE_WANA_WAYDROID
	help
	  Wana OS host integration for audio, Bluetooth and compatibility
	  services. Installs Wana service definitions and management helpers
	  on top of PipeWire/WirePlumber, BlueZ, D-Bus and LXC.
```

## platform/package/wana-python-gbinder/Config.in
```kconfig
config BR2_PACKAGE_WANA_PYTHON_GBINDER
	bool "wana-python-gbinder"
	depends on BR2_PACKAGE_PYTHON3
	depends on BR2_USE_MMU
	depends on BR2_TOOLCHAIN_HAS_THREADS
	select BR2_PACKAGE_HOST_PYTHON_CYTHON
	select BR2_PACKAGE_WANA_LIBGBINDER
	help
	  Python bindings for libgbinder used by Waydroid on Wana OS.

	  https://github.com/waydroid/gbinder-python
```

## platform/package/wana-render/Config.in
```kconfig
config BR2_PACKAGE_WANA_RENDER
	bool "wana-render"
	depends on BR2_PACKAGE_HOST_RUSTC_TARGET_ARCH_SUPPORTS
	depends on BR2_PACKAGE_HAS_LIBEGL && BR2_PACKAGE_HAS_LIBGLES && BR2_PACKAGE_HAS_LIBGBM
	select BR2_PACKAGE_HOST_RUSTC
	select BR2_PACKAGE_WANA_DRM
	help
	  Wana OS renderer: GBM + EGL + OpenGL ES on top of wana-drm,
	  and the wana-gl bring-up tool.

comment "wana-render needs EGL, OpenGL ES and GBM (mesa3d)"
	depends on !(BR2_PACKAGE_HAS_LIBEGL && BR2_PACKAGE_HAS_LIBGLES && BR2_PACKAGE_HAS_LIBGBM)
```

## platform/package/wana-text/Config.in
```kconfig
config BR2_PACKAGE_WANA_TEXT
	bool "wana-text"
	depends on BR2_PACKAGE_HOST_RUSTC_TARGET_ARCH_SUPPORTS
	depends on BR2_INSTALL_LIBSTDCPP # harfbuzz
	depends on BR2_TOOLCHAIN_HAS_SYNC_4 # harfbuzz
	depends on BR2_TOOLCHAIN_GCC_AT_LEAST_4_9 # harfbuzz
	select BR2_PACKAGE_HOST_RUSTC
	select BR2_PACKAGE_FREETYPE # harfbuzz font loading; rasterization later
	select BR2_PACKAGE_HARFBUZZ
	select BR2_PACKAGE_LIBFRIBIDI
	select BR2_PACKAGE_WANA_FONTS
	help
	  Wana OS text (decision 0002): the pinned UI fonts verified
	  against SHA256SUMS and loaded through HarfBuzz, shaping
	  (HarfBuzz) and BiDi (FriBidi); layout follows. Installs
	  the wana-text bring-up tool.

comment "wana-text needs a toolchain w/ C++, gcc >= 4.9"
	depends on !BR2_INSTALL_LIBSTDCPP || !BR2_TOOLCHAIN_GCC_AT_LEAST_4_9
```

## platform/package/wana-waydroid/Config.in
```kconfig
config BR2_PACKAGE_WANA_WAYDROID
	bool "wana-waydroid"
	depends on BR2_x86_64
	depends on BR2_USE_MMU
	depends on BR2_USE_WCHAR
	depends on !BR2_STATIC_LIBS
	depends on BR2_TOOLCHAIN_HAS_THREADS
	depends on BR2_INSTALL_LIBSTDCPP
	depends on BR2_TOOLCHAIN_HAS_SYNC_4
	depends on BR2_TOOLCHAIN_GCC_AT_LEAST_7
	depends on BR2_HOST_GCC_AT_LEAST_8
	depends on BR2_PACKAGE_HOST_RUSTC_ARCH_SUPPORTS
	depends on BR2_TOOLCHAIN_USES_GLIBC || BR2_TOOLCHAIN_USES_MUSL
	depends on BR2_PACKAGE_HAS_LIBEGL
	depends on !BR2_OPTIMIZE_FAST
	depends on BR2_PACKAGE_GOBJECT_INTROSPECTION_ARCH_SUPPORTS
	select BR2_PACKAGE_PYTHON3
	select BR2_PACKAGE_PYTHON3_SSL
	select BR2_PACKAGE_PYTHON3_XZ
	select BR2_PACKAGE_PYTHON3_ZLIB
	select BR2_PACKAGE_DBUS
	select BR2_PACKAGE_DBUS_PYTHON
	select BR2_PACKAGE_PYTHON_GOBJECT
	select BR2_PACKAGE_LIBGTK3
	select BR2_PACKAGE_LIBGTK3_WAYLAND
	select BR2_PACKAGE_POLKIT
	select BR2_PACKAGE_IPTABLES
	select BR2_PACKAGE_CA_CERTIFICATES
	select BR2_PACKAGE_LXC
	select BR2_PACKAGE_WANA_PYTHON_GBINDER
	help
	  Waydroid 1.6.3 adapted to Wana OS: no systemd requirement,
	  Wana's own service manager supervises the privileged container
	  manager and the desktop session talks to it over D-Bus.

	  https://github.com/waydroid/waydroid
```

## platform/package/wana-wine64/Config.in
```kconfig
config BR2_PACKAGE_WANA_WINE64
	bool "wana-wine64"
	depends on BR2_x86_64
	depends on !BR2_STATIC_LIBS
	depends on BR2_TOOLCHAIN_HAS_THREADS_NPTL
	depends on BR2_PACKAGE_WAYLAND
	select BR2_PACKAGE_ALSA_LIB
	select BR2_PACKAGE_DBUS
	select BR2_PACKAGE_FONTCONFIG
	select BR2_PACKAGE_FREETYPE
	select BR2_PACKAGE_PULSEAUDIO
	help
	  Wana OS 64-bit Wine compatibility runtime built with the native
	  Wayland driver. This avoids the i386-only constraint of Buildroot's
	  stock Wine package while keeping Wana OS itself x86_64-only.

	  https://www.winehq.org/

comment "wana-wine64 needs x86_64, Wayland, dynamic libraries and NPTL"
	depends on !BR2_x86_64 || BR2_STATIC_LIBS || !BR2_TOOLCHAIN_HAS_THREADS_NPTL || !BR2_PACKAGE_WAYLAND
```
